int IRledPin = 3; // LED Infravermelho conectado ao pino digital 3
unsigned const int liga[199] PROGMEM = {4448, 4376, 576, 1608, 580, 540, 556, 1636, 556, 1632, 556, 540, 560,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 1636, 524}; // botao de ligar
unsigned const int desliga[199] PROGMEM = {4472, 4368, 576, 1612, 576, 540, 556, 1636, 556, 1632, 556, 540, 560,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 1636, 524}; // botao de desligar
unsigned const int tempUm[199] PROGMEM = {4504, 4320, 632, 1576, 612, 488, 612, 1580, 608, 1580, 612, 484, 612,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 1580, 528}; // botao de ajustar temperatura em 18 graus
unsigned const int tempDois[199] PROGMEM = {4444, 4368, 580, 1608, 576, 540, 560, 1632, 560, 1628, 560, 540, 556,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 1632, 532}; // botao de ajustar temperatura em 19 graus
unsigned const int tempTres[199] PROGMEM = {4468, 4364, 580, 1632, 556, 540, 560, 1632, 560, 1628, 556, 540, 560,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 1632, 532}; // botao de ajustar temperatura em 20 graus
unsigned const int tempQuatro[199] PROGMEM = {4388, 4412, 580, 1632, 556, 540, 556, 1636, 556, 1632, 556, 540, 560,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 1632, 524}; // botao de ajustar temperatura em 21 graus
unsigned const int tempCinco[199] PROGMEM = {4448, 4388, 560, 1628, 560, 520, 576, 1612, 580, 1628, 560, 540, 556,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 1636, 524}; // botao de ajustar temperatura em 22 graus
unsigned int pulse;

void setup() {
  // put your setup code here, to run once:
  pinMode(IRledPin, OUTPUT); // Define modo do pino 3 como saída
  Serial.begin(9600); // Inicializa a serial
}

void loop() {
  if (Serial.available()) {
    char ser = Serial.read();
    if(ser == '1') {
      ligaAr();
    }
    else if (ser == '2') {
      desligaAr();
    }
    else if (ser == '3') {
      diminuiTempDois();
    }
    else if (ser == '4') {
      diminuiTempUm();
    }
    else if (ser == '5') {
      TempPadrao();
    }
    else if (ser == '6') {
      aumentaTempUm();
    }
    else if (ser == '7') {
      aumentaTempDois();
    }
  }
}

void ligaAr(){
  for(byte i = 0; i < 199; i++){
    pulse = pgm_read_word_near(liga + i);
    if (i % 2 == 0){
      pulseIR(pulse);
    }
    else {
      delayMicroseconds(pulse);
    }
  }
}

void desligaAr(){
  for(byte i = 0; i < 199; i++){
    pulse = pgm_read_word_near(desliga + i);
    if (i % 2 == 0){
      pulseIR(pulse);
    }
    else {
      delayMicroseconds(pulse);
    }
  }
}

void TempPadrao(){
  for(byte i = 0; i < 199; i++){
    pulse = pgm_read_word_near(tempTres + i);
    if (i % 2 == 0){
      pulseIR(pulse);
    }
    else {
      delayMicroseconds(pulse);
    }
  }
}

void diminuiTempUm(){
  for(byte i = 0; i < 199; i++){
    pulse = pgm_read_word_near(tempDois + i);
    if (i % 2 == 0){
      pulseIR(pulse);
    }
    else {
      delayMicroseconds(pulse);
    }
  }
}

void diminuiTempDois(){
  for(byte i = 0; i < 199; i++){
    pulse = pgm_read_word_near(tempUm + i);
    if (i % 2 == 0){
      pulseIR(pulse);
    }
    else {
      delayMicroseconds(pulse);
    }
  }
}

void aumentaTempUm(){
  for(byte i = 0; i < 199; i++){
    pulse = pgm_read_word_near(tempQuatro + i);
    if (i % 2 == 0){
      pulseIR(pulse);
    }
    else {
      delayMicroseconds(pulse);
    }
  }
}

void aumentaTempDois(){
  for(byte i = 0; i < 199; i++){
    pulse = pgm_read_word_near(tempCinco + i);
    if (i % 2 == 0){
      pulseIR(pulse);
    }
    else {
      delayMicroseconds(pulse);
    }
  }
}

void pulseIR(long microsecs) {
  cli(); // desativa quaisquer interrupções
  while (microsecs > 0) {
    // Em 38 kHz, 1 Hz tem cerca de 13 microssegundos em nível lógico alto e 13 microssegundos em baixo
    digitalWrite(IRledPin, HIGH);  // liga o LED. A execução desta linha leva cerca de 3 microsegundos
    delayMicroseconds(10);         // aguarda por 10 microseconds
    digitalWrite(IRledPin, LOW);   // desliga o LED. A execução desta linha leva cerca de 3 microsegundos
    delayMicroseconds(10);         // aguarda por 10 microseconds

    microsecs -= 26; // contador regressivo. Como cada ciclo (1 Hz) acima leva 26 microsegundos para ser executado, o while é executado até a condição não ser mais atendida
  }
  sei(); // habilita interrupções
}
